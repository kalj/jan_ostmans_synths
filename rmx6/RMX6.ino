// RMX-6 (Rhythm Multiple Exits) drum chip

// Copyright 2016 DSP Synthesizers Sweden. 
// 
// Author: Jan Ostman 
// 
// This program is free software: you can redistribute it and/or modify 
// it under the terms of the GNU General Public License as published by 
// the Free Software Foundation, either version 3 of the License, or 
// (at your option) any later version. 
// This program is distributed in the hope that it will be useful, 
// but WITHOUT ANY WARRANTY; without even the implied warranty of 
// MERCHANTABILITY or FITNESS FOR A PARTICULAR PURPOSE.  See the 
// GNU General Public License for more details. 

//Set Fuses to E2 DF FF for Internal 16MHz Clock

#include <avr/interrupt.h>
#include <avr/io.h>
#include <avr/pgmspace.h>

#define F_CPU 16000000L
#define USART_BAUDRATE 31250 
#define BAUD_PRESCALE (((F_CPU / (USART_BAUDRATE * 16UL))) - 1)

#ifndef cbi
#define cbi(sfr, bit) (_SFR_BYTE(sfr) &= ~_BV(bit))
#endif
#ifndef sbi
#define sbi(sfr, bit) (_SFR_BYTE(sfr) |= _BV(bit))
#endif 

// Standard Arduino Pins
#define digitalPinToPortReg(P)                                          \
  (((P) >= 0 && (P) <= 7) ? &PORTD : (((P) >= 8 && (P) <= 13) ? &PORTB : &PORTC))
#define digitalPinToDDRReg(P)                                           \
  (((P) >= 0 && (P) <= 7) ? &DDRD : (((P) >= 8 && (P) <= 13) ? &DDRB : &DDRC))
#define digitalPinToPINReg(P)                                           \
  (((P) >= 0 && (P) <= 7) ? &PIND : (((P) >= 8 && (P) <= 13) ? &PINB : &PINC))
#define digitalPinToBit(P)                                              \
  (((P) >= 0 && (P) <= 7) ? (P) : (((P) >= 8 && (P) <= 13) ? (P) - 8 : (P) - 14))

#define digitalReadFast(P) bitRead(*digitalPinToPINReg(P), digitalPinToBit(P))
                  
#define digitalWriteFast(P, V) bitWrite(*digitalPinToPortReg(P), digitalPinToBit(P), (V))


#define TOGD2 PORTD ^= 4

const unsigned char PS_2 = (1 << ADPS0);;
const unsigned char PS_4 = (1 << ADPS1);
const unsigned char PS_8 = (1 << ADPS1) | (1 << ADPS0);
const unsigned char PS_16 = (1 << ADPS2);
const unsigned char PS_32 = (1 << ADPS2) | (1 << ADPS0);
const unsigned char PS_64 = (1 << ADPS2) | (1 << ADPS1);
const unsigned char PS_128 = (1 << ADPS2) | (1 << ADPS1) | (1 << ADPS0);

const uint8_t BD[2848] PROGMEM = {
  129,134,207,255,250,252,248,249,246,246,244,244,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22,
  23,24,25,26,27,28,28,29,30,31,32,33,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212,
  212,211,210,210,209,209,208,207,207,206,206,205,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68,
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  129,129,129,129,129,129,129,129,129,129,129,129,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128
};

const uint8_t SN[2240] PROGMEM =
  {
    127,134,154,163,167,173,176,176,176,175,174,173,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102,
    141,133,111,117,112,141,127,87,90,133,130,109,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121,
    121,118,88,104,133,126,124,138,129,106,100,84,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150,
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    127,127,127,127,127,128,127,128,128,127,127,128,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128
  };

const uint8_t HH[4944] PROGMEM =
  {
    127,129,134,135,135,131,132,129,105,142,109,110,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173,
    151,69,127,170,107,110,147,77,120,176,126,131,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92,
    152,142,105,128,144,116,123,130,113,136,155,153,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124,
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    127,129,129,127,127,129,128,127,128,129,128,128,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128
  };

const uint8_t TO[1840] PROGMEM =
  {
    127,138,202,239,245,245,238,231,222,213,202,194,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78,
    77,77,77,78,79,80,82,84,86,88,91,93,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150,
    152,154,157,158,160,161,163,163,164,164,164,164,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135,
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    128,128,128,128,128,128,128,128,128,128,128,128,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128
  };

const uint8_t CY[10624] PROGMEM =
  {
    128,133,143,136,116,118,123,148,147,121,116,113,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135,
    130,120,116,77,123,198,160,119,57,68,165,186,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146,
    127,112,88,122,152,149,160,123,101,99,139,148,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138,
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    128,128,128,128,128,128,128,128,128,128,128,128,128,128,128,128,128,128,128,128,128,128,128,128,128,128,128,128
  };

volatile uint8_t MIDISTATE=0;
volatile uint8_t MIDIRUNNINGSTATUS=0;
volatile uint8_t MIDINOTE;
volatile uint8_t MIDIVEL;
volatile uint8_t MIDItriggers[8]={0xFF,0xFF,0xFF,0xFF,0xFF,0xFF,0xFF,0xFF};

ISR(USART_RX_vect) {
  uint8_t MIDIRX;

  MIDIRX = UDR0;

  /*
    Handling â€œRunning statusâ€
    1.Buffer is cleared (ie, set to 0) at power up.
    2.Buffer stores the status when a Voice Category Status (ie, 0x80 to 0xEF) is received.
    3.Buffer is cleared when a System Common Category Status (ie, 0xF0 to 0xF7) is received.
    4.Nothing is done to the buffer when a RealTime Category message is received.
    5.Any data bytes are ignored when the buffer is 0.
  */

  if ((MIDIRX>0xBF)&&(MIDIRX<0xF8)) {
    MIDIRUNNINGSTATUS=0;
    MIDISTATE=0;
    return;
  }

  if (MIDIRX>0xF7) return;

  if (MIDIRX & 0x80) {
    MIDIRUNNINGSTATUS=MIDIRX;
    MIDISTATE=1;
    return;
  }

  if (MIDIRX < 0x80) {
    if (!MIDIRUNNINGSTATUS) return;
    if (MIDISTATE==1) {
      MIDINOTE=MIDIRX;
      MIDISTATE++;
      return;
    }
    if (MIDISTATE==2) {
      MIDIVEL=MIDIRX;
      MIDISTATE=1;
      if ((MIDIRUNNINGSTATUS==0x8F)||(MIDIRUNNINGSTATUS==0x9F)) handleMIDINOTE(MIDIRUNNINGSTATUS,MIDINOTE,MIDIVEL);
      //if (MIDIRUNNINGSTATUS==0xB0) handleMIDICC(MIDINOTE,MIDIVEL);

      return;
    }
  }

  return;
}

void handleMIDINOTE(uint8_t MIDIcmd,uint8_t MIDInote,uint8_t MIDIvel) {
  if ((MIDIcmd==0x9F)&&(MIDIvel==0x00)) MIDIcmd=0x8F;
  if (MIDIcmd==0x9F) {
    MIDItriggers[MIDInote & 0x07] = 0x00;
  }
  if (MIDIcmd==0x8F) {
    MIDItriggers[MIDInote & 0x07] = 0xFF;
  } 
}



void setup() {

  OSCCAL=0xFE;
  
  pinMode(1,OUTPUT);
    
  //6 DAC outputs
  pinMode(2,INPUT_PULLUP);
  pinMode(4,INPUT_PULLUP);
  pinMode(7,INPUT_PULLUP);
  pinMode(8,INPUT_PULLUP);
  pinMode(12,INPUT_PULLUP);
  pinMode(13,INPUT_PULLUP);
    
  pinMode(5,OUTPUT);
  pinMode(6,OUTPUT);
  pinMode(9,OUTPUT);
  pinMode(10,OUTPUT);
  pinMode(3,OUTPUT);
  pinMode(11,OUTPUT);

  cli();
    
  TCCR0A = ((1<<COM0B1)|(1<<COM0A1)|(1<<WGM01)|(1<<WGM00));    
  TCCR0B = ((0<<CS01)|(1<<CS00));

  TCCR1A = (1<<WGM10)|(1<<COM1A1)   // Set up the two Control registers of Timer1. 
    |(1<<COM1B1);             // Wave Form Generation is Fast PWM 8 Bit, 
  TCCR1B = (1<<WGM12)|(1<<CS12)     // OC1A and OC1B are cleared on compare match 
    |(1<<CS10);               // and set at BOTTOM. Clock Prescaler is 1024.
  TCCR1B = (TCCR1B & ~(_BV(CS12) | _BV(CS11))) | _BV(CS10); //No prescaler

  TCCR2A = _BV(COM2A1) | _BV(COM2B1) | _BV(WGM21) | _BV(WGM20);
  TCCR2B = _BV(CS20);
    
  TIMSK0 = 0;
  TIMSK1 = 0;
  TIMSK2 = 0;

  OCR0A = 127;
  OCR0B = 127;
  OCR1A = 127;
  OCR1B = 127;
  OCR2A = 127;
  OCR2B = 127;
    
  sei();

   
  // Set baud rate to 31,250. Requires modification if clock speed is not 16MHz.
  UCSR0B = (1 << RXEN0);   // Turn on reception circuitry 
  UCSR0C = (1 << UCSZ00) | (1 << UCSZ01); // Use 8-bit character sizes 

  UBRR0H = (BAUD_PRESCALE >> 8); // Load upper 8-bits of the baud rate value into the high byte of the UBRR register 
  UBRR0L = BAUD_PRESCALE; // Load lower 8-bits of the baud rate value into the low byte of the UBRR register

  // USART RX interrupt enable bit on
  UCSR0B |= _BV(RXCIE0);

  // set up the ADC
  uint16_t SFREQ=analogRead(0);
  ADCSRA &= ~PS_128;  // remove bits set by Arduino library
  // Choose prescaler PS_128.
  ADCSRA |= PS_32;
  ADMUX = 64;
  sbi(ADCSRA, ADSC);

}

void loop() {
  uint8_t phaccBD,phaccSD,phaccCH,phaccOH,phaccLT,phaccHT,phaccCY;
  uint8_t pitchBD=128;
  uint8_t pitchSD=128;
  uint8_t pitchCH=128;
  uint8_t pitchOH=128;
  uint8_t pitchLT=128;
  uint8_t pitchCY=128;

  uint16_t samplecntBD,samplecntSD,samplecntCH,samplecntOH,samplecntLT,samplecntCY;
  uint16_t samplepntBD,samplepntSD,samplepntCH,samplepntOH,samplepntLT,samplepntCY;
  
  int16_t total;
  uint8_t oldPORTB;
  uint8_t oldPORTD;

  uint8_t divider;
  uint8_t MUX=0;
  
  while(1) { 
  
    if (!(ADCSRA & 64)) {
          
      if (samplecntBD) {
        phaccBD+=pitchBD;
        if (phaccBD & 128) {
          phaccBD &= 127;
          OCR2B=pgm_read_byte_near(BD + samplepntBD);
          samplepntBD++;
          samplecntBD--;
                
        }
      }
      if (samplecntSD) {
        phaccSD+=pitchSD;
        if (phaccSD & 128) {
          phaccSD &= 127;
          OCR0B=pgm_read_byte_near(SN + samplepntSD);
          samplepntSD++;
          samplecntSD--;
                
        }
      }
      if (samplecntCH) {
        phaccCH+=pitchCH;
        if (phaccCH & 128) {
          phaccCH &= 127;
          OCR0A=pgm_read_byte_near(HH + samplepntCH);
          samplepntCH++;
          samplecntCH--;
                
        }
      }
      if (samplecntOH) {
        phaccOH+=pitchOH;
        if (phaccOH & 128) {
          phaccOH &= 127;
          OCR1A=pgm_read_byte_near(HH + samplepntOH);
          samplepntOH++;
          samplecntOH--;
                
        }
      }    
      if (samplecntLT) {
        phaccLT+=pitchLT;
        if (phaccLT & 128) {
          phaccLT &= 127;
          OCR1B=pgm_read_byte_near(TO + samplepntLT);
          samplepntLT++;
          samplecntLT--;
                
        }
      }  
      if (samplecntCY) {
        phaccCY+=pitchCY;
        if (phaccCY & 128) {
          phaccCY &= 127;
          OCR2A=pgm_read_byte_near(CY + samplepntCY);
          samplepntCY++;
          samplecntCY--;
                
        }
      }  

      uint16_t pitch=((ADCL+(ADCH<<8))>>3)+1;

      if (MUX==0) pitchBD=pitch;
      if (MUX==1) pitchSD=pitch;
      if (MUX==2) pitchCH=pitch;
      if (MUX==3) pitchOH=pitch;
      if (MUX==4) pitchLT=pitch;
      if (MUX==5) pitchCY=pitch;

      MUX++;
      if (MUX==6) MUX=0;
      ADMUX = 64 | MUX; //Select MUX
      sbi(ADCSRA, ADSC); //start next conversation
    }


    //----------------- Handle Triggers ------------------------------

    if ((digitalReadFast(2))&&(MIDItriggers[0])) {
      samplepntBD=0;
      samplecntBD=2848;
    }
    if ((digitalReadFast(4)) && (MIDItriggers[1])) {
      samplepntSD=0;
      samplecntSD=2240;
    }
    if ((digitalReadFast(7)) && (MIDItriggers[2])) {
      samplepntCH=0;
      samplecntCH=1500;
    }
    if ((digitalReadFast(8)) && (MIDItriggers[3])) {
      samplepntOH=0;
      samplecntOH=4944;
    }
    if ((digitalReadFast(12)) && (MIDItriggers[4])) {
      samplepntLT=0;
      samplecntLT=1840;
    }
    if ((digitalReadFast(13)) && (MIDItriggers[5])) {
      samplepntCY=0;
      samplecntCY=10624;
    }

    //-----------------------------------------------------------------



      
  }
}

